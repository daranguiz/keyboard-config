## zmk/config/boards/corneish_zen.conf
```kconfig
# ZMK Board Configuration: Corneish-Zen
# Board ID: corneish_zen
# Shield: corneish_zen
# Generated: 2025-11-17 01:16:02 UTC

# Basic features
CONFIG_ZMK_KEYBOARD_NAME="Corneish-Zen"
CONFIG_ZMK_SLEEP=y

# Battery reporting (for wireless boards)
CONFIG_ZMK_BATTERY_REPORTING=y

# Bluetooth settings
CONFIG_BT_CTLR_TX_PWR_PLUS_8=y

# Optional features (uncomment as needed)
# CONFIG_ZMK_RGB_UNDERGLOW=y
# CONFIG_ZMK_BACKLIGHT=y
# CONFIG_ZMK_DISPLAY=y
# CONFIG_ZMK_WIDGET_WPM_STATUS=y
# CONFIG_ZMK_WIDGET_BATTERY_STATUS=y

# Add board-specific features below 

# From here https://github.com/urob/zmk-config/blob/main/config/corneish_zen.conf
CONFIG_CUSTOM_WIDGET_LAYER_STATUS=n
```

## zmk/config/boards/totem.conf
```kconfig
# Battery reporting (for wireless boards)
CONFIG_ZMK_BATTERY_REPORTING=y

# Bluetooth settings
CONFIG_BT_CTLR_TX_PWR_PLUS_8=y
```

## zmk/config/modules/dario/contextual-hold-tap/Kconfig
```kconfig
menuconfig DARIO_CONTEXTUAL_HOLD_TAP
    bool "Contextual hold-tap behavior"
    default y
    depends on DT_HAS_DARIO_BEHAVIOR_CONTEXTUAL_HOLD_TAP_ENABLED
    help
      Hold-tap variant that switches flavor after configurable prior keycodes.

if DARIO_CONTEXTUAL_HOLD_TAP

config DARIO_CONTEXTUAL_HT_MAX_HELD
    int "Max simultaneously held contextual hold-taps"
    default 10
    help
      Maximum number of simultaneously held contextual hold-tap keys.

config DARIO_CONTEXTUAL_HT_MAX_CAPTURED_EVENTS
    int "Max captured events"
    default 40
    help
      Maximum number of captured events while resolving contextual hold-tap presses.

config DARIO_CONTEXTUAL_HT_LOG
    bool "Enable contextual hold-tap debug logging"
    default n
    help
      When enabled, debug logs will be emitted during flavor selection and resolution.

endif
```

## zmk/config/modules/dario/contextual-hold-tap/dts/bindings/behaviors/dario,behavior-contextual-hold-tap.yaml
```yaml
# Whitespace-conditional (contextual) hold-tap behavior
#
# Copyright (c) 2025
# SPDX-License-Identifier: MIT

description: Contextual hold-tap behavior that switches flavor based on the previously emitted keycode

compatible: "dario,behavior-contextual-hold-tap"

include: zero_param.yaml

properties:
  tap-bindings:
    type: phandle-array
    required: true
    description: Behaviors invoked for the tap decision (in order)

  hold-bindings:
    type: phandle-array
    required: true
    description: Behaviors invoked for the hold decision (in order)

  tapping-term-ms:
    type: int
    default: 200
    description: Tapping term window for hold/tap resolution

  tapping_term_ms:
    type: int
    deprecated: true

  quick-tap-ms:
    type: int
    default: 0
    description: Quick tap window (0 disables)

  quick_tap_ms:
    type: int
    deprecated: true

  require-prior-idle-ms:
    type: int
    default: -1
    description: Require idle time before enabling quick tap (mirrors ZMK hold-tap)

  normal-flavor:
    type: string
    enum:
      - "balanced"
      - "tap-preferred"
      - "hold-preferred"
    default: "balanced"
    description: Flavor used normally

  after-flavor:
    type: string
    enum:
      - "balanced"
      - "tap-preferred"
      - "hold-preferred"
    default: "hold-preferred"
    description: Flavor used after a matched prior keycode within the timeout

  prior-keycodes:
    type: array
    default: [SPACE]
    description: Keycodes that trigger after-flavor when most recently emitted

  prior-timeout-ms:
    type: int
    default: 300
    description: Window (ms) during which the prior keycode influences flavor

  hold-while-undecided:
    type: boolean
    description: Mirror of ZMK hold-tap option

  hold-while-undecided-linger:
    type: boolean
    description: Mirror of ZMK hold-tap option

  retro-tap:
    type: boolean
    description: Mirror of ZMK hold-tap option

  hold-trigger-key-positions:
    type: array
    default: []
    description: Positions that allow hold when first other key is pressed

  hold-trigger-on-release:
    type: boolean
    description: Mirror of ZMK hold-tap option
```

## zmk/config/west.yml
```yaml
manifest:
  remotes:
    - name: zmkfirmware
      url-base: https://github.com/zmkfirmware
    - name: urob
      url-base: https://github.com/urob
    - name: victorlucachi
      url-base: https://github.com/victorlucachi
  projects:
    - name: zmk
      remote: zmkfirmware
      revision: v0.3.0  # pinning because https://zmk.dev/blog/2025/12/09/zephyr-4-1
      import: app/west.yml
    - name: zmk-adaptive-key
      remote: urob
      revision: v0.3.0
      path: modules/zmk/adaptive-key
    - name: zmk-keyboards-totem
      remote: victorlucachi
      revision: main
  self:
    path: config
```
