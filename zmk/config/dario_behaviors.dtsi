/*
 * Dario's Custom ZMK Behaviors
 *
 * Only contains macros - all timing configuration is in config/keymap.yaml
 * and generated into the keymap file.
 */

/ {
    macros {
        github_url: github_url_macro {
            compatible = "zmk,behavior-macro";
            label = "GITHUB_URL";
            #binding-cells = <0>;
            bindings
                = <&macro_wait_time 10>  // add per-key spacing so long macros don't get dropped
                , <&macro_tap_time 10>
                , <&macro_tap &kp H &kp T &kp T &kp P &kp S &kp COLON &kp FSLH &kp FSLH &kp G &kp I>
                , <&macro_tap &kp T &kp H &kp U &kp B &kp DOT &kp C &kp O &kp M &kp FSLH &kp D>
                , <&macro_tap &kp A &kp R &kp A &kp N &kp G &kp U &kp I &kp Z &kp FSLH &kp K>
                , <&macro_tap &kp E &kp Y &kp B &kp O &kp A &kp R &kp D &kp MINUS &kp C &kp O>
                , <&macro_tap &kp N &kp F &kp I &kp G &kp QMARK &kp T &kp A &kp B &kp EQUAL &kp R>
                , <&macro_tap &kp E &kp A &kp D &kp M &kp E &kp MINUS &kp O &kp V &kp MINUS &kp F>
                , <&macro_tap &kp I &kp L &kp E &kp HASH &kp R &kp E &kp A &kp D &kp M &kp E>
                ;
        };
    };
};
